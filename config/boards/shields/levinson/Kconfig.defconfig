## config/boards/shields/levinson/Kconfig.defconfig
```kconfig
# Copyright (c) 2021 The ZMK Contributors
# SPDX-License-Identifier: MIT
 
if split
config ZMK_KEYBOARD_NAME
	default "Split Numpad"
endif
```

## config/boards/shields/levinson/Kconfig.shield
```kconfig
# Copyright (c) 2021 The ZMK Contributors
# SPDX-License-Identifier: MIT

config SHIELD_SPLIT
	def_bool $(shields_list_contains,split)
```
